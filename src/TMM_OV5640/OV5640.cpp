#include "OV5640.h"
#include "OV5640_regs.h"

#define debug Serial
// #define NO_CLK_PIN

#define DEBUG_CAMERA
// #define DEBUG_CAMERA_VERBOSE
// #define DEBUG_FLEXIO
// #define USE_DEBUG_PINS
#define DEBUG_CAMERA_REG
#define USE_VSYNC_PIN_INT

// #define USE_DEBUG_PINS_TIMING

#ifdef USE_DEBUG_PINS_TIMING
#define DBGdigitalWriteFast digitalWriteFast
#define DBGdigitalToggleFast digitalToggleFast
#else
static inline void DBGdigitalWriteFast(uint8_t pin, uint8_t val)
    __attribute__((always_inline, unused));
static inline void DBGdigitalWriteFast(uint8_t pin, uint8_t val) {}
static inline void DBGdigitalToggleFast(uint8_t pin)
    __attribute__((always_inline, unused));
static inline void DBGdigitalToggleFast(uint8_t pin){}
#endif

// if not defined in the variant
#ifndef digitalPinToBitMask
#define digitalPinToBitMask(P) (1 << (digitalPinToPinName(P) % 64))
#endif

#ifndef portInputRegister
#define portInputRegister(P) ((P == 0) ? &NRF_P0->IN : &NRF_P1->IN)
#endif

/** ln(10) */
#ifndef LN10
#define LN10 2.30258509299404568402f
#endif /* !M_LN10 */

/* log_e 2 */
#ifndef LN2
#define LN2 0.69314718055994530942
#endif /*!M_LN2 */

#define LOG2_2(x) (((x) & 0x2ULL) ? (2) : 1) // NO ({ ... }) !
#define LOG2_4(x)                                                              \
    (((x) & 0xCULL) ? (2 + LOG2_2((x) >> 2)) : LOG2_2(x)) // NO ({ ... }) !
#define LOG2_8(x)                                                              \
    (((x) & 0xF0ULL) ? (4 + LOG2_4((x) >> 4)) : LOG2_4(x)) // NO ({ ... }) !
#define LOG2_16(x)                                                             \
    (((x) & 0xFF00ULL) ? (8 + LOG2_8((x) >> 8)) : LOG2_8(x)) // NO ({ ... }) !
#define LOG2_32(x)                                                             \
    (((x) & 0xFFFF0000ULL) ? (16 + LOG2_16((x) >> 16))                         \
                           : LOG2_16(x)) // NO ({ ... }) !
#define LOG2(x)                                                                \
    (((x) & 0xFFFFFFFF00000000ULL) ? (32 + LOG2_32((x) >> 32))                 \
                                   : LOG2_32(x)) // NO ({ ... }) !

// Sensor frame size/resolution table.
const int resolution[][2] = {
    {640, 480},   /* VGA   */
    {160, 120},   /* QQVGA */
    {320, 240},   /* QVGA  */
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    {1280, 1024}, /* SXGA  */
    // 3MP Sensors
    {1920, 1080}, /* FHD   */
    {720, 1280},  /* Portrait HD   */
    {864, 1536},  /* Portrait 3MP   */
    {2048, 1536}, /* QXGA  */
    // 5MP Sensors
    {2560, 1440}, /* QHD    */
    {2560, 1600}, /* WQXGA  */
    {1088, 1920}, /* Portrait FHD   */
    {2560, 1920}, /* QSXGA  */
    {0, 0},
};

#define BLANK_LINES 8
#define DUMMY_LINES 6

#define BLANK_COLUMNS 0
#define DUMMY_COLUMNS 16

#define SENSOR_WIDTH 2624
#define SENSOR_HEIGHT 1964

#define ACTIVE_SENSOR_WIDTH (SENSOR_WIDTH - BLANK_COLUMNS - (2 * DUMMY_COLUMNS))
#define ACTIVE_SENSOR_HEIGHT (SENSOR_HEIGHT - BLANK_LINES - (2 * DUMMY_LINES))

#define DUMMY_WIDTH_BUFFER 16
#define DUMMY_HEIGHT_BUFFER 8

#define HSYNC_TIME 252
#define VYSNC_TIME 24

static int16_t readout_x = 0;
static int16_t readout_y = 0;

static uint16_t readout_w = ACTIVE_SENSOR_WIDTH;
static uint16_t readout_h = ACTIVE_SENSOR_HEIGHT;

static uint16_t hts_target = 0;

static const uint8_t default_regs[][3] = {

    // https://github.com/ArduCAM/Arduino/blob/master/ArduCAM/ov5640_regs.h

    {0x47, 0x40, 0x20},
    {0x40, 0x50, 0x6e},
    {0x40, 0x51, 0x8f},
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    {0x30, 0x35, 0x11},                 // { 0x30, 0x35, 0x21 },
    {0x30, 0x36, OMV_OV5640_PLL_CTRL2}, // { 0x30, 0x36, 0x46 },
    {0x30, 0x37, OMV_OV5640_PLL_CTRL3},
    {0x30, 0x38, 0x00},
    {0x30, 0x39, 0x00},
    {0x38, 0x0c, 0x07},
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    {0x30, 0x08, 0x02},

    // OpenMV Custom.

    {0x3a, 0x02, 0x07},
    {0x3a, 0x03, 0xae},
    {0x3a, 0x08, 0x01},
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    {0x47, 0x23, 0x03}, // DVP JPEG Mode456 Skip Line Number

    // End.

    {0x00, 0x00, 0x00}};

#if (OMV_OV5640_AF_ENABLE == 1)
static const uint8_t af_firmware_regs[] = {
    0x02, 0x0f, 0xd6, 0x02, 0x0a, 0x39, 0xc2, 0x01, 0x22, 0x22, 0x00, 0x02,
    0x0f, 0xb2, 0xe5, 0x1f, 0x70, 0x72, 0xf5, 0x1e, 0xd2, 0x35, 0xff, 0xef,
    0x25, 0xe0, 0x24, 0x4e, 0xf8, 0xe4, 0xf6, 0x08, 0xf6, 0x0f, 0xbf, 0x34,
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    0x8e, 0x83, 0x75, 0xf0, 0x04, 0xed, 0x02, 0x06, 0xa5};

static const uint8_t af_firmware_command_regs[][3] = {

    {0x30, 0x22, 0x03}, {0x30, 0x23, 0x00}, {0x30, 0x24, 0x00},
    {0x30, 0x25, 0x00}, {0x30, 0x26, 0x00}, {0x30, 0x27, 0x00},
    {0x30, 0x28, 0x00}, {0x30, 0x29, 0x7f},

    {0x00, 0x00, 0x00}};
#endif

#define NUM_BRIGHTNESS_LEVELS (9)

#define NUM_CONTRAST_LEVELS (7)
static const uint8_t contrast_regs[NUM_CONTRAST_LEVELS][1] = {
    {0x14}, /* -3 */
    {0x18}, /* -2 */
    {0x1C}, /* -1 */
    {0x00}, /* +0 */
    {0x10}, /* +1 */
    {0x18}, /* +2 */
    {0x1C}, /* +3 */
};

#define NUM_SATURATION_LEVELS (7)
static const uint8_t saturation_regs[NUM_SATURATION_LEVELS][6] = {
    {0x0c, 0x30, 0x3d, 0x3e, 0x3d, 0x01}, /* -3 */
    {0x10, 0x3d, 0x4d, 0x4e, 0x4d, 0x01}, /* -2 */
    {0x15, 0x52, 0x66, 0x68, 0x66, 0x02}, /* -1 */
    {0x1a, 0x66, 0x80, 0x82, 0x80, 0x02}, /* +0 */
    {0x1f, 0x7a, 0x9a, 0x9c, 0x9a, 0x02}, /* +1 */
    {0x24, 0x8f, 0xb3, 0xb6, 0xb3, 0x03}, /* +2 */
    {0x2b, 0xab, 0xd6, 0xda, 0xd6, 0x04}, /* +3 */
};

#define NUM_WB_MODES (5)
static const uint8_t wb_modes_regs[NUM_WB_MODES][7] = {
    {0x00, 0x04, 0x00, 0x04, 0x00, 0x04, 0x00}, /* auto */
    {0x01, 0x06, 0x1c, 0x04, 0x00, 0x04, 0xf3}, /* sunny */
    {0x01, 0x06, 0x48, 0x04, 0x00, 0x04, 0xd3}, /* cloudy */
    {0x01, 0x05, 0x48, 0x04, 0x00, 0x07, 0xcf}, /* office */
    {0x01, 0x04, 0x10, 0x04, 0x00, 0x08, 0x50}, /* home */
};

#define NUM_SPECIAL_EFFECTS (9)
static const uint8_t special_effects_regs[NUM_SPECIAL_EFFECTS][4] = {
    {0x06, 0x40, 0x10, 0x08}, /* no effect */
    {0x40, 0x08, 0x40, 0x10}, /* negative */
    {0x1e, 0x80, 0x80, 0x08}, /* black and white */
    {0x1e, 0x80, 0xc0, 0x08}, /* reddish */
    {0x1e, 0x60, 0x60, 0x08}, /* greenish */
    {0x1e, 0xa0, 0x40, 0x08}, /* blue */
    {0x1e, 0x40, 0xa0, 0x08}, /* retro */
    {0x1e, 0xf0, 0xf0, 0x08}, /* Overexposure */
    {0x06, 0x40, 0x10, 0x09}  /* Solarize */

};

const int OV5640_D[8] = {OV5640_D0, OV5640_D1, OV5640_D2, OV5640_D3,
                         OV5640_D4, OV5640_D5, OV5640_D6, OV5640_D7};

OV5640::OV5640()
    : _OV5640(NULL), _saturation(3), _hue(0), _frame_buffer_pointer(NULL) {

    setPins(OV5640_XCLK, OV5640_PLK, OV5640_VSYNC, OV5640_HREF, OV5640_RST,
            OV5640_D0, OV5640_D1, OV5640_D2, OV5640_D3, OV5640_D4, OV5640_D5,
            OV5640_D6, OV5640_D7, Wire);
}

// Read a single uint8_t from address and return it as a uint8_t
uint8_t OV5640::cameraReadRegister(uint16_t reg_addr, uint8_t *reg_data) {
    _wire->beginTransmission(0x78);
    _wire->write(reg_addr >> 8);
    _wire->write(reg_addr);
    if (_wire->endTransmission(false) != 0) {
        if (_debug)
            debug.println("error reading OV5640, address");
        return 0;
    }
    if (_wire->requestFrom(0x78, 1) < 1) {
        Serial.println("error reading OV5640, data");
        return 0;
    }
    int ret = _wire->read();
    if (ret < 0) {
        return 1;
    } else {
        uint8_t ret_data = (uint8_t)ret;
        reg_data = &ret_data;
    }
    return 0;
}

uint8_t OV5640::cameraWriteRegister(uint16_t reg, uint8_t data) {
    _wire->beginTransmission(0x78);
    _wire->write(reg >> 8);
    _wire->write(reg);
    _wire->write(data);
    if (_wire->endTransmission() != 0) {
        if (_debug)
            debug.println("error writing to HM0360");
        return 1;
    }
    return 0;
}

// HTS (Horizontal Time) is the readout width plus the HSYNC_TIME time. However,
// if this value gets too low the OV5640 will crash. The minimum was determined
// empirically with testing... Additionally, when the image width gets too large
// we need to slow down the line transfer rate by increasing HTS so that
// DCMI_DMAConvCpltUser() can keep up with the data rate.
//
// WARNING! IF YOU CHANGE ANYTHING HERE RETEST WITH **ALL** RESOLUTIONS FOR THE
// AFFECTED MODE!
int OV5640::calculate_hts(uint16_t width) {
    uint16_t hts = hts_target;

    if ((_format == GRAYSCALE) || (_format == BAYER) || (_format == JPEG)) {
        if (width <= 1280) {
            hts = max((width * 2) + 8, hts_target);
        }
    } else {
        if (width > 640) {
            hts = max((width * 2) + 8, hts_target);
        }
    }

    if (width <= 640) {
        hts += 160; // Fix image quality at low resolutions.
    }
    return max(hts + HSYNC_TIME,
               (SENSOR_WIDTH + HSYNC_TIME) / 2); // Fix to prevent crashing.
}

// VTS (Vertical Time) is the readout height plus the VYSNC_TIME time. However,
// if this value gets too low the OV5640 will crash. The minimum was determined
// empirically with testing...
//
// WARNING! IF YOU CHANGE ANYTHING HERE RETEST WITH **ALL** RESOLUTIONS FOR THE
// AFFECTED MODE!
int OV5640::calculate_vts(uint16_t readout_height) {
    return max(readout_height + VYSNC_TIME,
               (SENSOR_HEIGHT + VYSNC_TIME) / 8); // Fix to prevent crashing.
}

uint16_t OV5640::getModelid() {
    uint8_t Data = 0;
    uint16_t MID = 0x0000;

    cameraReadRegister(0x300A, &Data);
    MID = (Data << 8);

    cameraReadRegister(0x300B, &Data);
    MID |= Data;

    return MID;
}

bool OV5640::begin_omnivision(framesize_t framesize, pixformat_t format,
                              int fps, int camera_name, bool use_gpio) {

    _use_gpio = use_gpio;
// BUGBUG::: see where frame is
#ifdef USE_DEBUG_PINS
    pinMode(49, OUTPUT);
#endif

    //_wire = &Wire;
    _wire->begin();

    // Configure Camera Resolution
    _width = resolution[framesize][0];
    if (_width == 0) {
        if (_debug)
            debug.println("Frame Size Invalid!!!");
        return false;
    }
    _height = resolution[framesize][1];
    _framesize = (uint8_t)framesize;

    // Configure pixel format
    _grayscale = false;
    switch (format) {
    case YUV422:
        _bytesPerPixel = 2;
        _format = 0;
        break;
    case PIXFORMAT_BAYER:
    case BAYER:
        _bytesPerPixel = 2;
        _format = 1;
        break;
    case RGB565:
        _bytesPerPixel = 2;
        _format = 2;
        break;
    case PIXFORMAT_GRAYSCALE:
    case GRAYSCALE:
        format = YUV422;    // We use YUV422 but discard U and V bytes
        _bytesPerPixel = 2; // 2 input bytes per pixel of which 1 is discarded
        _grayscale = true;
        _format = 4;
        break;
    case JPEG:
        _bytesPerPixel = 2;
        _format = 8;
        break;
    default:
        return false;
    }

    pinMode(_vsyncPin, INPUT /*INPUT_PULLDOWN*/);
    //  const struct digital_pin_bitband_and_config_table_struct *p;
    //  p = digital_pin_to_info_PGM + _vsyncPin;
    //  *(p->pad) = IOMUXC_PAD_DSE(7) | IOMUXC_PAD_HYS;  // See if I turn on
    //  HYS...
    pinMode(_hrefPin, INPUT_PULLUP);
    pinMode(_pclkPin, INPUT_PULLDOWN);
    pinMode(_xclkPin, OUTPUT);

#ifdef DEBUG_CAMERA
    debug.printf("  VS=%d, HR=%d, PC=%d XC=%d\n", _vsyncPin, _hrefPin, _pclkPin,
                 _xclkPin);
    debug.printf("  RST=%d\n", _rst);

    for (int i = 0; i < 8; i++) {
        pinMode(_dPins[i], INPUT);
        debug.printf("  _dpins(%d)=%d\n", i, _dPins[i]);
    }
#endif

    _vsyncPort = portInputRegister(digitalPinToPort(_vsyncPin));
    _vsyncMask = digitalPinToBitMask(_vsyncPin);
    _hrefPort = portInputRegister(digitalPinToPort(_hrefPin));
    _hrefMask = digitalPinToBitMask(_hrefPin);
    _pclkPort = portInputRegister(digitalPinToPort(_pclkPin));
    _pclkMask = digitalPinToBitMask(_pclkPin);

    /*
      if(camera_name == OV7670) {
          _xclk_freq = 14;  //was 16Mhz
      } else {
          if(fps <= 10){
           _xclk_freq = 14;
          } else {
          _xclk_freq = 16;
          }
      }
    */

    beginXClk();

    if (_rst != 0xFF) {
        pinMode(_rst, OUTPUT);
        digitalWriteFast(_rst, LOW); /* Reset */
        for (volatile uint32_t i = 0; i < 100000; i++) {
        }
        digitalWriteFast(_rst, HIGH); /* Normal mode. */
        for (volatile uint32_t i = 0; i < 100000; i++) {
        }
    }

    _wire->begin();

    delay(1000);

    if (getModelid() != 0x5640) {
        end();
        if (_debug)
            debug.println("Camera detect failed");
        return false;
    }

#ifdef DEBUG_CAMERA
    debug.printf("Calling ov7670_configure\n");
    debug.printf("Cam Name: %d, Format: %d, Resolution: %d, Clock: %d\n",
                 camera_name, _format, _framesize, _xclk_freq);
    debug.printf("Frame rate: %d\n", fps);
#endif

    // flexIO/DMA
    if (!_use_gpio) {
        flexio_configure();
        setVSyncISRPriority(102);
        setDMACompleteISRPriority(192);
    } else {
        setVSyncISRPriority(102);
        setDMACompleteISRPriority(192);
    }

    reset();
    if (setPixformat(format) != 0) {
        if (_debug)
            debug.println("Error: setPixformat failed");
        return false;
    }
    if (setFramesize(framesize) != 0) {
        if (_debug)
            debug.println("Error: setFramesize failed");
        return false; // failed to set resolution
    }

    // for now frame rate is fixed

    return true;
}

int OV5640::reset() {
    int ret = 0;
    readout_x = 0;
    readout_y = 0;

    readout_w = ACTIVE_SENSOR_WIDTH;
    readout_h = ACTIVE_SENSOR_HEIGHT;

    hts_target = 0;

    // Reset all registers
    ret |= cameraWriteRegister(SCCB_SYSTEM_CTRL_1, 0x11);
    ret |= cameraWriteRegister(SYSTEM_CTROL0, 0x82);

    // Delay 5 ms
    delay(5);

    // Write default registers
    for (int i = 0; default_regs[i][0]; i++) {
        int addr = (default_regs[i][0] << 8) | (default_regs[i][1] << 0);
        int data = default_regs[i][2];

#if (OMV_OV5640_REV_Y_CHECK == 1)
        // Rev V (480 MHz / 20) -> 24 MHz PCLK / 3 * 100 = 800 MHz / 10 = 80 MHz
        // PCLK. Rev Y (400 MHz / 16) -> 25 MHz PCLK / 3 * 84 = 700 MHz / 10 =
        // 70 MHz PCLK.
        if (HAL_GetREVID() < 0x2003) {
            // Is this REV Y?
            if (addr == SC_PLL_CONTRL2) {
                data = OMV_OV5640_REV_Y_CTRL2;
            }
            if (addr == SC_PLL_CONTRL3) {
                data = OMV_OV5640_REV_Y_CTRL3;
            }
        }
#endif

        ret |= cameraWriteRegister(addr, data);
    }

#if (OMV_OV5640_AF_ENABLE == 1)
/*
    ret |= cameraWriteRegister(SYSTEM_RESET_00, 0x20); // force mcu reset

    // Write firmware
    ret |= omv_i2c_write_bytes(&sensor->i2c_bus, sensor->slv_addr,
                               (uint8_t *)&fw_addr, 2, OMV_I2C_XFER_SUSPEND);
    ret |= omv_i2c_write_bytes(&sensor->i2c_bus, sensor->slv_addr,
                               (uint8_t *)af_firmware_regs,
                               sizeof(af_firmware_regs), OMV_I2C_XFER_NO_FLAGS);

    for (int i = 0; af_firmware_command_regs[i][0]; i++) {
        ret |= cameraWriteRegister((af_firmware_command_regs[i][0] << 8) |
                                       (af_firmware_command_regs[i][1] << 0),
                                   af_firmware_command_regs[i][2]);
    }

    ret |= cameraWriteRegister(SYSTEM_RESET_00, 0x00); // release mcu reset
*/
#endif
    delay(300);

    return ret;
}

void OV5640::beginXClk() {
    analogWriteFrequency(_xclkPin, _xclk_freq * 1000000);
    analogWrite(_xclkPin, 127);
    delay(100); // 9mhz works, but try to reduce to debug timings with logic
                // analyzer
}

void OV5640::endXClk() { analogWrite(OV5640_XCLK, 0); }

void OV5640::end() {
    endXClk();
    pinMode(_xclkPin, INPUT);
    _wire->end();
}

int OV5640::setPixformat(pixformat_t pixformat) {
    // const uint8_t(*regs)[2];
    int ret = 0;

    switch (pixformat) {
    case GRAYSCALE:
    case PIXFORMAT_GRAYSCALE:
        ret |= cameraWriteRegister(FORMAT_CONTROL, 0x10);
        ret |= cameraWriteRegister(FORMAT_CONTROL_MUX, 0x00);
        break;
    case RGB565:
        ret |= cameraWriteRegister(FORMAT_CONTROL, 0x6F);
        ret |= cameraWriteRegister(FORMAT_CONTROL_MUX, 0x01);
        break;
    case YUV422:
        ret |= cameraWriteRegister(FORMAT_CONTROL, 0x30);
        ret |= cameraWriteRegister(FORMAT_CONTROL_MUX, 0x00);
        break;
    case BAYER:
    case PIXFORMAT_BAYER:
        ret |= cameraWriteRegister(FORMAT_CONTROL, 0x00);
        ret |= cameraWriteRegister(FORMAT_CONTROL_MUX, 0x01);
        break;
    case JPEG:
        ret |= cameraWriteRegister(FORMAT_CONTROL, 0x30);
        ret |= cameraWriteRegister(FORMAT_CONTROL_MUX, 0x00);
        break;
    default:
        return 1;
    }

    _format = int(pixformat);
    return ret;
}

uint8_t OV5640::setFramesize(framesize_t framesize) {
    if (framesize >= (sizeof(resolution) / sizeof(resolution[0])))
        return 1; // error

    _framesize = (uint8_t)framesize;

    return setFramesize(resolution[framesize][0], resolution[framesize][1]);
}

uint8_t OV5640::setFramesize(int w, int h) {
    uint16_t sensor_w = 0;
    uint16_t sensor_h = 0;

    if ((w == 0) || (h == 0))
        return 1; // not valid

    _width = w;
    _height = h;

    uint8_t reg = 0;
    int ret = 0;
    // uint16_t w = resolution[framesize][0];
    // uint16_t h = resolution[framesize][1];

    // Not a multiple of 8. The JPEG encoder on the OV5640 can't handle this.
    if ((_format == JPEG) && ((w % 8) || (h % 8))) {
        return 1;
    }

    // Readout speed too fast. The DCMI_DMAConvCpltUser() line callback overhead
    // is too much to handle the line transfer speed. If we were to slow the
    // pixclk down these resolutions would work. As of right now, the image
    // shakes and scrolls with the current line transfer speed. Note that
    // there's an overhead to the DCMI_DMAConvCpltUser() function. It's not the
    // memory copy operation that's too slow. It's that there's too much
    // overhead in the DCMI_DMAConvCpltUser() method to even have time to start
    // the line transfer. If it were possible to slow the line readout speed of
    // the OV5640 this would enable these resolutions below. However, there's
    // nothing in the datasheet that when modified does this.
    if (((_format == GRAYSCALE) || (_format == BAYER) || (_format == JPEG))) {
        return 1;
    }

    // Invalid resolution.
    if ((w > ACTIVE_SENSOR_WIDTH) || (h > ACTIVE_SENSOR_HEIGHT)) {
        return 1;
    }

    // Step 0: Clamp readout settings.

    readout_w = max(readout_w, w);
    readout_h = max(readout_h, h);

    int readout_x_max = (ACTIVE_SENSOR_WIDTH - readout_w) / 2;
    int readout_y_max = (ACTIVE_SENSOR_HEIGHT - readout_h) / 2;
    readout_x = max(min(readout_x, readout_x_max), -readout_x_max);
    readout_y = max(min(readout_y, readout_y_max), -readout_y_max);

    // Step 1: Determine readout area and subsampling amount.

    uint16_t sensor_div = 0;

    if ((w > (readout_w / 2)) || (h > (readout_h / 2))) {
        sensor_div = 1;
    } else {
        sensor_div = 2;
    }

    // Step 2: Determine horizontal and vertical start and end points.

    sensor_w = readout_w +
               DUMMY_WIDTH_BUFFER; // camera hardware needs dummy pixels to sync
    sensor_h = readout_h +
               DUMMY_HEIGHT_BUFFER; // camera hardware needs dummy lines to sync

    uint16_t sensor_ws =
        max(min((((ACTIVE_SENSOR_WIDTH - sensor_w) / 4) + (readout_x / 2)) * 2,
                ACTIVE_SENSOR_WIDTH - sensor_w),
            -(DUMMY_WIDTH_BUFFER / 2)) +
        DUMMY_COLUMNS; // must be multiple of 2
    uint16_t sensor_we = sensor_ws + sensor_w - 1;

    uint16_t sensor_hs =
        max(min((((ACTIVE_SENSOR_HEIGHT - sensor_h) / 4) - (readout_y / 2)) * 2,
                ACTIVE_SENSOR_HEIGHT - sensor_h),
            -(DUMMY_HEIGHT_BUFFER / 2)) +
        DUMMY_LINES; // must be multiple of 2
    uint16_t sensor_he = sensor_hs + sensor_h - 1;

    // Step 3: Determine scaling window offset.

    float ratio = min((readout_w / sensor_div) / ((float)w),
                      (readout_h / sensor_div) / ((float)h));

    uint16_t w_mul = w * ratio;
    uint16_t h_mul = h * ratio;
    uint16_t x_off = ((sensor_w / sensor_div) - w_mul) / 2;
    uint16_t y_off = ((sensor_h / sensor_div) - h_mul) / 2;

    // Step 4: Compute total frame time.

    hts_target = sensor_w / sensor_div;

    uint16_t sensor_hts = calculate_hts(w);
    uint16_t sensor_vts = calculate_vts(sensor_h / sensor_div);

    uint16_t sensor_x_inc =
        (((sensor_div * 2) - 1) << 4) |
        (1 << 0); // odd[7:4]/even[3:0] pixel inc on the bayer pattern
    uint16_t sensor_y_inc =
        (((sensor_div * 2) - 1) << 4) |
        (1 << 0); // odd[7:4]/even[3:0] pixel inc on the bayer pattern

    if (_debug) {
        debug.println("Setting FrameSize:");
        debug.println("  Step 0:");
        debug.printf("   readout_w: %d, readout_h: %d, readout_x_max: %d, "
                     "readout_x_max: %d\n",
                     readout_w, readout_h, readout_x_max, readout_y_max);
        debug.printf("   readout_x: %d, readout_y: %d\n", readout_x, readout_y);
        debug.println("  Step 1:");
        debug.printf("   sensor_div: %d\n", sensor_div);
        debug.println("  Step 2:");
        debug.printf(
            "  sensor_w: %d, sensor_h: %d, sensor_ws: %d, sensor_we: %d\n",
            sensor_w, sensor_h, sensor_ws, sensor_we);
        debug.printf("  sensor_hs: %d, sensor_hs: %d\n", sensor_hs, sensor_he);
        debug.printf("  Step 3:");
        debug.printf("  ratio: %d, w_mul: %d, h_mul: %d\n", ratio, w_mul,
                     h_mul);
        debug.printf("  x_off: %d, y_off: %d\n", x_off, y_off);
        debug.printf("  Step 4:");
        debug.printf("  hts_target: %d, sensor_hts: %d, sensor_vts: %d: %d\n",
                     hts_target, sensor_hts, sensor_vts);
        debug.printf("  sensor_x_inc: %d, sensor_x_inc:%d\n", sensor_x_inc,
                     sensor_x_inc);
    }

    // Step 5: Write regs.

    ret |= cameraWriteRegister(TIMING_HS_H, sensor_ws >> 8);
    ret |= cameraWriteRegister(TIMING_HS_L, sensor_ws);

    ret |= cameraWriteRegister(TIMING_VS_H, sensor_hs >> 8);
    ret |= cameraWriteRegister(TIMING_VS_L, sensor_hs);

    ret |= cameraWriteRegister(TIMING_HW_H, sensor_we >> 8);
    ret |= cameraWriteRegister(TIMING_HW_L, sensor_we);

    ret |= cameraWriteRegister(TIMING_VH_H, sensor_he >> 8);
    ret |= cameraWriteRegister(TIMING_VH_L, sensor_he);

    ret |= cameraWriteRegister(TIMING_DVPHO_H, w >> 8);
    ret |= cameraWriteRegister(TIMING_DVPHO_L, w);

    ret |= cameraWriteRegister(TIMING_DVPVO_H, h >> 8);
    ret |= cameraWriteRegister(TIMING_DVPVO_L, h);

    ret |= cameraWriteRegister(TIMING_HTS_H, sensor_hts >> 8);
    ret |= cameraWriteRegister(TIMING_HTS_L, sensor_hts);

    ret |= cameraWriteRegister(TIMING_VTS_H, sensor_vts >> 8);
    ret |= cameraWriteRegister(TIMING_VTS_L, sensor_vts);

    ret |= cameraWriteRegister(TIMING_HOFFSET_H, x_off >> 8);
    ret |= cameraWriteRegister(TIMING_HOFFSET_L, x_off);

    ret |= cameraWriteRegister(TIMING_VOFFSET_H, y_off >> 8);
    ret |= cameraWriteRegister(TIMING_VOFFSET_L, y_off);

    ret |= cameraWriteRegister(TIMING_X_INC, sensor_x_inc);
    ret |= cameraWriteRegister(TIMING_Y_INC, sensor_y_inc);

    ret |= cameraReadRegister(TIMING_TC_REG_20, &reg);
    ret |=
        cameraWriteRegister(TIMING_TC_REG_20, (reg & 0xFE) | (sensor_div > 1));

    ret |= cameraReadRegister(TIMING_TC_REG_21, &reg);
    ret |=
        cameraWriteRegister(TIMING_TC_REG_21, (reg & 0xFE) | (sensor_div > 1));

    ret |= cameraWriteRegister(VFIFO_HSIZE_H, w >> 8);
    ret |= cameraWriteRegister(VFIFO_HSIZE_L, w);

    ret |= cameraWriteRegister(VFIFO_VSIZE_H, h >> 8);
    ret |= cameraWriteRegister(VFIFO_VSIZE_L, h);

    return ret;
}

void OV5640::setContrast(int level) {
    int ret = 0;

    int new_level = level + (NUM_CONTRAST_LEVELS / 2);
    if (new_level < 0 || new_level >= NUM_CONTRAST_LEVELS) {
        level = 2;
    }

    ret |= cameraWriteRegister(0x3212, 0x03); // start group 3
    ret |= cameraWriteRegister(0x5586, (new_level + 5) << 2);
    ret |= cameraWriteRegister(0x5585, contrast_regs[new_level][0]);
    ret |= cameraWriteRegister(0x3212, 0x13); // end group 3
    ret |= cameraWriteRegister(0x3212, 0xa3); // launch group 3

    // return ret;
}

int OV5640::setBrightness(int level) {
    int ret = 0;

    int new_level = level + (NUM_BRIGHTNESS_LEVELS / 2);
    if (new_level < 0 || new_level >= NUM_BRIGHTNESS_LEVELS) {
        level = 2;
    }

    ret |= cameraWriteRegister(0x3212, 0x03); // start group 3
    ret |= cameraWriteRegister(0x5587, abs(level) << 4);
    ret |= cameraWriteRegister(0x5588, (level < 0) ? 0x09 : 0x01);
    ret |= cameraWriteRegister(0x3212, 0x13); // end group 3
    ret |= cameraWriteRegister(0x3212, 0xa3); // launch group 3

    return ret;
}

void OV5640::setSaturation(int level) {
    int ret = 0;

    int new_level = level + (NUM_SATURATION_LEVELS / 2);
    if (new_level < 0 || new_level >= NUM_SATURATION_LEVELS) {
        level = 2;
    }

    ret |= cameraWriteRegister(0x3212, 0x03); // start group 3
    ret |= cameraWriteRegister(0x5581, 0x1c);
    ret |= cameraWriteRegister(0x5582, 0x5a);
    ret |= cameraWriteRegister(0x5583, 0x06);
    ret |= cameraWriteRegister(0x5584, saturation_regs[new_level][0]);
    ret |= cameraWriteRegister(0x5585, saturation_regs[new_level][1]);
    ret |= cameraWriteRegister(0x5586, saturation_regs[new_level][2]);
    ret |= cameraWriteRegister(0x5587, saturation_regs[new_level][3]);
    ret |= cameraWriteRegister(0x5588, saturation_regs[new_level][4]);
    ret |= cameraWriteRegister(0x5589, saturation_regs[new_level][5]);
    ret |= cameraWriteRegister(0x558b, 0x98);
    ret |= cameraWriteRegister(0x558a, 0x01);
    ret |= cameraWriteRegister(0x3212, 0x13); // end group 3
    ret |= cameraWriteRegister(0x3212, 0xa3); // launch group 3

    // return ret;
}

int OV5640::setGainceiling(gainceiling_t gainceiling) {
    uint8_t reg = 0;
    int ret = 0;

    int new_gainceiling = 16 << (gainceiling + 1);
    if (new_gainceiling >= 1024) {
        return 1;
    }

    ret |= cameraReadRegister(AEC_GAIN_CEILING_H, &reg);
    ret |= cameraWriteRegister(AEC_GAIN_CEILING_H,
                               (reg & 0xFC) | (new_gainceiling >> 8));
    ret |= cameraWriteRegister(AEC_GAIN_CEILING_L, new_gainceiling);

    return ret;
}

int OV5640::setQuality(int qs) {
    uint8_t reg = 0;
    int ret = cameraReadRegister(JPEG_CTRL07, &reg);
    ret |= cameraWriteRegister(JPEG_CTRL07, (reg & 0xC0) | (qs >> 2));

    return ret;
}

uint8_t OV5640::getQuality() {
    // int ret = 0;
    uint8_t reg = 0;

    /* Write QS register */
    cameraReadRegister(JPEG_CTRL07, &reg);
    return reg;
}

int OV5640::setColorbar(int enable) {
    uint8_t reg = 0;
    int ret = cameraReadRegister(PRE_ISP_TEST, &reg);
    return cameraWriteRegister(PRE_ISP_TEST,
                               (reg & 0x7F) | (enable ? 0x80 : 0x00)) |
           ret;
}

int OV5640::calc_pclk_freq(uint8_t sc_pll_ctrl_0, uint8_t sc_pll_ctrl_1,
                           uint8_t sc_pll_ctrl_2, uint8_t sc_pll_ctrl_3,
                           uint8_t sys_root_div) {
    uint32_t pclk_freq = _xclk_freq * 1000000;
    pclk_freq /= ((sc_pll_ctrl_3 & 0x10) != 0x00) ? 2 : 1;
    pclk_freq /= ((sc_pll_ctrl_0 & 0x0F) == 0x0A) ? 10 : 8;
    switch (sc_pll_ctrl_3 & 0x0F) {
    case 0:
        pclk_freq /= 1;
        break;
    case 1:
        pclk_freq /= 2;
        break;
    case 2:
        pclk_freq /= 3;
        break;
    case 3:
        pclk_freq /= 4;
        break;
    case 4:
        pclk_freq /= 6;
        break;
    case 5:
        pclk_freq /= 8;
        break;
    default:
        pclk_freq /= 3;
        break;
    }
    pclk_freq *= sc_pll_ctrl_2;
    sc_pll_ctrl_1 >>= 4;
    pclk_freq /= sc_pll_ctrl_1;
    switch (sys_root_div & 0x30) {
    case 0x00:
        pclk_freq /= 1;
        break;
    case 0x10:
        pclk_freq /= 2;
        break;
    case 0x20:
        pclk_freq /= 4;
        break;
    case 0x30:
        pclk_freq /= 8;
        break;
    default:
        pclk_freq /= 1;
        break;
    }
    return (int)pclk_freq;
}

int OV5640::setAutoExposure(int enable, int exposure_us) {
    uint8_t reg = 0;
    uint8_t spc0 = 0;
    uint8_t spc1 = 0;
    uint8_t spc2 = 0;
    uint8_t spc3 = 0;
    uint8_t sysrootdiv = 0;
    uint8_t hts_h = 0;
    uint8_t hts_l = 0;
    uint8_t vts_h = 0;
    uint8_t vts_l;

    int ret = cameraReadRegister(AEC_PK_MANUAL, &reg);
    ret |=
        cameraWriteRegister(AEC_PK_MANUAL, (reg & 0xFE) | ((enable == 0) << 0));

    if ((enable == 0) && (exposure_us >= 0)) {
        ret |= cameraReadRegister(SC_PLL_CONTRL0, &spc0);
        ret |= cameraReadRegister(SC_PLL_CONTRL1, &spc1);
        ret |= cameraReadRegister(SC_PLL_CONTRL2, &spc2);
        ret |= cameraReadRegister(SC_PLL_CONTRL3, &spc3);
        ret |= cameraReadRegister(SYSTEM_ROOT_DIVIDER, &sysrootdiv);

        ret |= cameraReadRegister(TIMING_HTS_H, &hts_h);
        ret |= cameraReadRegister(TIMING_HTS_L, &hts_l);

        ret |= cameraReadRegister(TIMING_VTS_H, &vts_h);
        ret |= cameraReadRegister(TIMING_VTS_L, &vts_l);

        uint16_t hts = (hts_h << 8) | hts_l;
        uint16_t vts = (vts_h << 8) | vts_l;

        int pclk_freq = calc_pclk_freq(spc0, spc1, spc2, spc3, sysrootdiv);
        int clocks_per_us = pclk_freq / 1000000;
        int exposure =
            max(min((exposure_us * clocks_per_us) / hts, 0xFFFF), 0x0000);

        int new_vts = max(exposure, vts);

        ret |= cameraWriteRegister(AEC_PK_EXPOSURE_0, exposure >> 12);
        ret |= cameraWriteRegister(AEC_PK_EXPOSURE_1, exposure >> 4);
        ret |= cameraWriteRegister(AEC_PK_EXPOSURE_2, exposure << 4);

        ret |= cameraWriteRegister(TIMING_VTS_H, new_vts >> 8);
        ret |= cameraWriteRegister(TIMING_VTS_L, new_vts);
    }

    return ret;
}

int OV5640::getExposure_us(int *exposure_us) {
    uint8_t spc0 = 0;
    uint8_t spc1 = 0;
    uint8_t spc2 = 0;
    uint8_t spc3 = 0;
    uint8_t sysrootdiv = 0;
    uint8_t hts_h = 0;
    uint8_t hts_l = 0;
    uint8_t vts_h = 0;
    uint8_t vts_l;
    uint8_t aec_0 = 0;
    uint8_t aec_1 = 0;
    uint8_t aec_2 = 0;
    int ret = 0;

    ret |= cameraReadRegister(SC_PLL_CONTRL0, &spc0);
    ret |= cameraReadRegister(SC_PLL_CONTRL1, &spc1);
    ret |= cameraReadRegister(SC_PLL_CONTRL2, &spc2);
    ret |= cameraReadRegister(SC_PLL_CONTRL3, &spc3);
    ret |= cameraReadRegister(SYSTEM_ROOT_DIVIDER, &sysrootdiv);

    ret |= cameraReadRegister(AEC_PK_EXPOSURE_0, &aec_0);
    ret |= cameraReadRegister(AEC_PK_EXPOSURE_1, &aec_1);
    ret |= cameraReadRegister(AEC_PK_EXPOSURE_2, &aec_2);

    ret |= cameraReadRegister(TIMING_HTS_H, &hts_h);
    ret |= cameraReadRegister(TIMING_HTS_L, &hts_l);

    ret |= cameraReadRegister(TIMING_VTS_H, &vts_h);
    ret |= cameraReadRegister(TIMING_VTS_L, &vts_l);

    uint32_t aec = ((aec_0 << 16) | (aec_1 << 8) | aec_2) >> 4;
    uint16_t hts = (hts_h << 8) | hts_l;
    uint16_t vts = (vts_h << 8) | vts_l;

    aec = min(aec, vts);

    int pclk_freq = calc_pclk_freq(spc0, spc1, spc2, spc3, sysrootdiv);
    int clocks_per_us = pclk_freq / 1000000;
    *exposure_us = (aec * hts) / clocks_per_us;

    return ret;
}

int OV5640::setAutoGain(int enable, float gain_db, float gain_db_ceiling) {
    uint8_t reg = 0;
    int ret = cameraReadRegister(AEC_PK_MANUAL, &reg);
    ret |=
        cameraWriteRegister(AEC_PK_MANUAL, (reg & 0xFD) | ((enable == 0) << 1));

    if ((enable == 0) && (!isnanf(gain_db)) && (!isinff(gain_db))) {
        int gain = max(
            min(fast_roundf(expf((gain_db / 20.0f) * M_LN10) * 16.0f), 1023),
            0);

        ret |= cameraReadRegister(AEC_PK_REAL_GAIN_H, &reg);
        ret |=
            cameraWriteRegister(AEC_PK_REAL_GAIN_H, (reg & 0xFC) | (gain >> 8));
        ret |= cameraWriteRegister(AEC_PK_REAL_GAIN_L, gain);
    } else if ((enable != 0) && (!isnanf(gain_db_ceiling)) &&
               (!isinff(gain_db_ceiling))) {
        int gain_ceiling = max(
            min(fast_roundf(expf((gain_db_ceiling / 20.0f) * M_LN10) * 16.0f),
                1023),
            0);

        ret |= cameraReadRegister(AEC_GAIN_CEILING_H, &reg);
        ret |= cameraWriteRegister(AEC_GAIN_CEILING_H,
                                   (reg & 0xFC) | (gain_ceiling >> 8));
        ret |= cameraWriteRegister(AEC_GAIN_CEILING_L, gain_ceiling);
    }

    return ret;
}

int OV5640::getGain_db(float *gain_db) {
    uint8_t gainh = 0;
    uint8_t gainl = 0;

    int ret = cameraReadRegister(AEC_PK_REAL_GAIN_H, &gainh);
    ret |= cameraReadRegister(AEC_PK_REAL_GAIN_L, &gainl);

    *gain_db = 20.0f * log10f((((gainh & 0x3) << 8) | gainl) / 16.0f);

    return ret;
}

int OV5640::setAutoWhitebal(int enable, float r_gain_db, float g_gain_db,
                            float b_gain_db) {
    uint8_t reg = 0;
    int ret = cameraReadRegister(AWB_MANUAL_CONTROL, &reg);
    ret |=
        cameraWriteRegister(AWB_MANUAL_CONTROL, (reg & 0xFE) | (enable == 0));

    if ((enable == 0) && (!isnanf(r_gain_db)) && (!isnanf(g_gain_db)) &&
        (!isnanf(b_gain_db)) && (!isinff(r_gain_db)) && (!isinff(g_gain_db)) &&
        (!isinff(b_gain_db))) {

        int r_gain =
            max(min(fast_roundf(expf((r_gain_db / 20.0f) * M_LN10)), 4095), 0);
        int g_gain =
            max(min(fast_roundf(expf((g_gain_db / 20.0f) * M_LN10)), 4095), 0);
        int b_gain =
            max(min(fast_roundf(expf((b_gain_db / 20.0f) * M_LN10)), 4095), 0);

        ret |= cameraWriteRegister(AWB_R_GAIN_H, r_gain >> 8);
        ret |= cameraWriteRegister(AWB_R_GAIN_L, r_gain);
        ret |= cameraWriteRegister(AWB_G_GAIN_H, g_gain >> 8);
        ret |= cameraWriteRegister(AWB_G_GAIN_L, g_gain);
        ret |= cameraWriteRegister(AWB_B_GAIN_H, b_gain >> 8);
        ret |= cameraWriteRegister(AWB_B_GAIN_L, b_gain);
    }

    return ret;
}

int OV5640::getRGB_Gain_db(float *r_gain_db, float *g_gain_db,
                           float *b_gain_db) {
    uint8_t redh = 0;
    uint8_t redl = 0;
    uint8_t greenh = 0;
    uint8_t greenl = 0;
    uint8_t blueh = 0;
    uint8_t bluel = 0;

    int ret = cameraReadRegister(AWB_R_GAIN_H, &redh);
    ret |= cameraReadRegister(AWB_R_GAIN_L, &redl);
    ret |= cameraReadRegister(AWB_G_GAIN_H, &greenh);
    ret |= cameraReadRegister(AWB_G_GAIN_L, &greenl);
    ret |= cameraReadRegister(AWB_B_GAIN_H, &blueh);
    ret |= cameraReadRegister(AWB_B_GAIN_L, &bluel);

    *r_gain_db = 20.0f * log10f(((redh & 0xF) << 8) | redl);
    *g_gain_db = 20.0f * log10f(((greenh & 0xF) << 8) | greenl);
    *b_gain_db = 20.0f * log10f(((blueh & 0xF) << 8) | bluel);

    return ret;
}

int OV5640::setHmirror(int enable) {
    uint8_t reg = 0;
    int ret = cameraReadRegister(TIMING_TC_REG_21, &reg);
    if (enable) {
        ret |= cameraWriteRegister(TIMING_TC_REG_21, reg | 0x06);
    } else {
        ret |= cameraWriteRegister(TIMING_TC_REG_21, reg & 0xF9);
    }
    return ret;
}

int OV5640::setVflip(int enable) {
    uint8_t reg = 0;
    int ret = cameraReadRegister(TIMING_TC_REG_20, &reg);
    if (!enable) {
        ret |= cameraWriteRegister(TIMING_TC_REG_20, reg | 0x06);
    } else {
        ret |= cameraWriteRegister(TIMING_TC_REG_20, reg & 0xF9);
    }
    return ret;
}

int OV5640::setWBmode(int mode) {
    int ret = 0;
    if (mode < 0 || mode > NUM_WB_MODES) {
        ret |= cameraWriteRegister(0x3212, 0x03); // start group 3
        ret |= cameraWriteRegister(0x3406, wb_modes_regs[0][0]);
        ret |= cameraWriteRegister(0x3400, wb_modes_regs[0][1]);
        ret |= cameraWriteRegister(0x3401, wb_modes_regs[0][2]);
        ret |= cameraWriteRegister(0x3402, wb_modes_regs[0][3]);
        ret |= cameraWriteRegister(0x3403, wb_modes_regs[0][4]);
        ret |= cameraWriteRegister(0x3404, wb_modes_regs[0][5]);
        ret |= cameraWriteRegister(0x3405, wb_modes_regs[0][6]);
        ret |= cameraWriteRegister(0x3212, 0x13); // end group 3
        ret |= cameraWriteRegister(0x3212, 0xa3); // lanuch group 3
        return 1;
    }

    ret |= cameraWriteRegister(0x3212, 0x03); // start group 3
    ret |= cameraWriteRegister(0x3406, wb_modes_regs[mode][0]);
    ret |= cameraWriteRegister(0x3400, wb_modes_regs[mode][1]);
    ret |= cameraWriteRegister(0x3401, wb_modes_regs[mode][2]);
    ret |= cameraWriteRegister(0x3402, wb_modes_regs[mode][3]);
    ret |= cameraWriteRegister(0x3403, wb_modes_regs[mode][4]);
    ret |= cameraWriteRegister(0x3404, wb_modes_regs[mode][5]);
    ret |= cameraWriteRegister(0x3405, wb_modes_regs[mode][6]);
    ret |= cameraWriteRegister(0x3212, 0x13); // end group 3
    ret |= cameraWriteRegister(0x3212, 0xa3); // lanuch group 3

    return ret;
}

int OV5640::setSpecialEffect(sde_t sde) {
    int ret = 0;
    int effect = 0;

    effect = sde;
    effect++;
    if (effect <= 0 || effect > NUM_SPECIAL_EFFECTS) {
        return 1;
    }

    ret |= cameraWriteRegister(0x3212, 0x03); // start group 3
    ret |= cameraWriteRegister(0x5580, special_effects_regs[effect][0]);
    ret |=
        cameraWriteRegister(0x5583, special_effects_regs[effect][1]); // sat U
    ret |=
        cameraWriteRegister(0x5584, special_effects_regs[effect][2]); // sat V
    ret |= cameraWriteRegister(0x5003, special_effects_regs[effect][3]);
    ret |= cameraWriteRegister(0x3212, 0x13); // end group 3
    ret |= cameraWriteRegister(0x3212, 0xa3); // launch group 3

    return ret;
}

int OV5640::setAutoBlc(int enable, int *regs) {
    uint8_t reg = 0;
    int ret = cameraReadRegister(BLC_CTRL_00, &reg);
    ret |= cameraWriteRegister(BLC_CTRL_00, (reg & 0xFE) | (enable != 0));

    if ((enable == 0) && (regs != NULL)) {
        for (uint32_t i = 0; i < 8; i++) {
            ret |= cameraWriteRegister(BLACK_LEVEL_00_H + i, regs[i]);
        }
    }

    return ret;
}

int OV5640::getBlcRegs(int *regs) {
    int ret = 0;

    for (uint32_t i = 0; i < 8; i++) {
        uint8_t reg = 0;
        ret |= cameraReadRegister(BLACK_LEVEL_00_H + i, &reg);
        regs[i] = reg;
    }

    return ret;
}

/*******************************************************************/

#define FLEXIO_USE_DMA

size_t OV5640::readFrameGPIO_JPEG(void *buffer, size_t cb1, void *buffer2,
                                  size_t cb2) {
    uint16_t w = _width;
    uint16_t h = _height;
    uint32_t i_count = 0;

    debug.printf("$$readFrameGPIO(%p, %u, %p, %u)\n", buffer, cb1, buffer2,
                 cb2);
    const uint32_t frame_size_bytes = w * h * _bytesPerPixel / 5;
    if ((cb1 + cb2) < frame_size_bytes) {
        if (_debug)
            debug.printf("Warning Buffers may be too small %u < %u\n",
                         cb1 + cb2, frame_size_bytes);
    }
    DBGdigitalWriteFast(0, HIGH);
    uint8_t *b = (uint8_t *)buffer;
    uint32_t cb = (uint32_t)cb1;
    //  bool _grayscale;  // ????  member variable ?????????????
    int bytesPerRow = _width * _bytesPerPixel;

    // Falling edge indicates start of frame
    // pinMode(PCLK_PIN, INPUT); // make sure back to input pin...
    // lets add our own glitch filter.  Say it must be hig for at least 100us
    elapsedMicros emHigh;
    DBGdigitalWriteFast(0, LOW);
    do {
        while ((*_vsyncPort & _vsyncMask) == 0)
            ; // wait for HIGH
        emHigh = 0;
        while ((*_vsyncPort & _vsyncMask) != 0)
            ; // wait for LOW
    } while (emHigh < 1);

    // uint8_t *pu8 = (uint8_t *)b;
    uint8_t prev_char = 0;

    DBGdigitalWriteFast(0, HIGH);
    for (int i = 0; i < h; i++) {
        // rising edge indicates start of line
        while ((*_hrefPort & _hrefMask) == 0)
            ; // wait for HIGH
        while ((*_pclkPort & _pclkMask) != 0)
            ; // wait for LOW
        noInterrupts();

        for (int j = 0; j < bytesPerRow; j++) {
            // rising edges clock each data byte
            while ((*_pclkPort & _pclkMask) == 0)
                ; // wait for HIGH

            // uint32_t in = ((_frame_buffer_pointer)? GPIO1_DR : GPIO6_DR) >>
            // 18; // read all bits in parallel
            uint32_t in = (GPIO7_PSR >> 4); // read all bits in parallel

            // uint32_t in = mmBus;
            // bugbug what happens to the the data if grayscale?
            if (!(j & 1) || !_grayscale) {
                *b++ = in;
                cb--;
                if (cb == 0) {
                    if (buffer2) {
                        if (_debug)
                            debug.printf("\t$$ 2nd buffer: %u %u\n", i, j);
                        b = (uint8_t *)buffer2;
                        cb = (uint32_t)cb2;
                        buffer2 = nullptr;
                    } else {
                        if (_debug)
                            debug.printf("Error failed buffers too small\n");
                        interrupts();
                        DBGdigitalWriteFast(0, LOW);
                        return frame_size_bytes;
                    }
                }
            }

            if ((prev_char == 0xff) && ((uint8_t)in == 0xd9)) {
                interrupts();
                DBGdigitalWriteFast(0, LOW);
                return i_count + 1;
            }
            prev_char = (uint8_t)in;
            i_count = i_count + 1;

            while (((*_pclkPort & _pclkMask) != 0) &&
                   ((*_hrefPort & _hrefMask) != 0))
                ; // wait for LOW bail if _href is lost
        }

        while ((*_hrefPort & _hrefMask) != 0)
            ; // wait for LOW
        interrupts();
    }
    DBGdigitalWriteFast(0, LOW);

    return frame_size_bytes;
}

/*********************************************************************/

//======================================== DMA JUNK
//================================================================================
// experiment with DMA
//================================================================================
// Define our DMA structure.
DMAChannel OV5640::_dmachannel;
DMASetting OV5640::_dmasettings[10];
uint32_t OV5640::_dmaBuffer1[DMABUFFER_SIZE] __attribute__((used, aligned(32)));
uint32_t OV5640::_dmaBuffer2[DMABUFFER_SIZE] __attribute__((used, aligned(32)));
extern "C" void xbar_connect(unsigned int input,
                             unsigned int output); // in pwm.c

// OV2640 *OV5640::active_dma_camera = nullptr;

//===================================================================
// Start a DMA operation -
//===================================================================
#if 0 // def later
bool OV5640::startReadFrameDMA(bool(*callback)(void *frame_buffer), uint8_t *fb1, uint8_t *fb2) {return false;}
bool OV5640::stopReadFrameDMA() {return false;}

#else
bool OV5640::startReadFrameDMA(bool (*callback)(void *frame_buffer),
                               uint8_t *fb1, uint8_t *fb2) {
    // First see if we need to allocate frame buffers.
    if (fb1)
        _frame_buffer_1 = fb1;
    else if (_frame_buffer_1 == nullptr) {
        _frame_buffer_1 = (uint8_t *)malloc(_width * _height);
        if (_frame_buffer_1 == nullptr)
            return false;
    }
    if (fb2)
        _frame_buffer_2 = fb2;
    else if (_frame_buffer_2 == nullptr) {
        _frame_buffer_2 = (uint8_t *)malloc(_width * _height);
        if (_frame_buffer_2 == nullptr)
            return false; // BUGBUG should we 32 byte align?
    }
    // remember the call back if passed in
    _callback = callback;
    active_dma_camera = this;

    if (_debug)
        debug.printf("startReadFrameDMA called buffers %x %x\n",
                     (uint32_t)_frame_buffer_1, (uint32_t)_frame_buffer_2);

    // DebugDigitalToggle(OV7670_DEBUG_PIN_1);
    // lets figure out how many bytes we will tranfer per setting...
    //  _dmasettings[0].begin();
    _frame_row_buffer_pointer = _frame_buffer_pointer =
        (uint8_t *)_frame_buffer_1;

    // configure DMA channels
    _dmachannel.begin();
    _dmasettings[0].source(GPIO2_PSR); // setup source.
    _dmasettings[0].destinationBuffer(
        _dmaBuffer1, DMABUFFER_SIZE * 4); // 32 bits per logical byte
    _dmasettings[0].replaceSettingsOnCompletion(_dmasettings[1]);
    _dmasettings[0]
        .interruptAtCompletion(); // we will need an interrupt to process this.
    _dmasettings[0].TCD->CSR &=
        ~(DMA_TCD_CSR_DREQ); // Don't disable on this one
    // DebugDigitalToggle(OV7670_DEBUG_PIN_1);

    _dmasettings[1].source(GPIO2_PSR); // setup source.
    _dmasettings[1].destinationBuffer(
        _dmaBuffer2, DMABUFFER_SIZE * 4); // 32 bits per logical byte
    _dmasettings[1].replaceSettingsOnCompletion(_dmasettings[0]);
    _dmasettings[1]
        .interruptAtCompletion(); // we will need an interrupt to process this.
    _dmasettings[1].TCD->CSR &=
        ~(DMA_TCD_CSR_DREQ); // Don't disable on this one
    // DebugDigitalToggle(OV7670_DEBUG_PIN_1);

    GPIO2_GDIR = 0; // set all as input...
    GPIO2_DR = 0;   // see if I can clear it out...

    _dmachannel = _dmasettings[0]; // setup the first on...
    _dmachannel.attachInterrupt(dmaInterrupt);
    _dmachannel.triggerAtHardwareEvent(DMAMUX_SOURCE_XBAR1_0);
    // DebugDigitalToggle(OV7670_DEBUG_PIN_1);

    // Lets try to setup the DMA setup...
    // first see if we can convert the _pclk to be an XBAR Input pin...
    // OV7670_PLK   4
    // OV7670_PLK   8    //8       B1_00   FlexIO2:16  XBAR IO14

    _save_pclkPin_portConfigRegister = *(portConfigRegister(_pclkPin));
    *(portConfigRegister(_pclkPin)) = 1; // set to XBAR mode 14

    // route the timer outputs through XBAR to edge trigger DMA request
    CCM_CCGR2 |= CCM_CCGR2_XBAR1(CCM_CCGR_ON);
    xbar_connect(XBARA1_IN_IOMUX_XBAR_INOUT14, XBARA1_OUT_DMA_CH_MUX_REQ30);
    // DebugDigitalToggle(OV7670_DEBUG_PIN_1);

    // Tell XBAR to dDMA on Rising
    XBARA1_CTRL0 = XBARA_CTRL_STS0 | XBARA_CTRL_EDGE0(1) |
                   XBARA_CTRL_DEN0 /* | XBARA_CTRL_IEN0 */;

    IOMUXC_GPR_GPR6 &=
        ~(IOMUXC_GPR_GPR6_IOMUXC_XBAR_DIR_SEL_14); // Make sure it is input mode
    IOMUXC_XBAR1_IN14_SELECT_INPUT =
        1; // Make sure this signal goes to this pin...

#if defined(ARDUINO_TEENSY_MICROMOD)
    // Need to switch the IO pins back to GPI1 from GPIO6
    _save_IOMUXC_GPR_GPR27 =
        IOMUXC_GPR_GPR27; // save away the configuration before we change...
    IOMUXC_GPR_GPR27 &= ~(0x0ff0u);

    // lets also un map the _hrefPin to GPIO1
    IOMUXC_GPR_GPR27 &= ~_hrefMask; //
#else
    // Need to switch the IO pins back to GPI1 from GPIO6
    _save_IOMUXC_GPR_GPR26 =
        IOMUXC_GPR_GPR26; // save away the configuration before we change...
    IOMUXC_GPR_GPR26 &= ~(0x0ff0u);

    // lets also un map the _hrefPin to GPIO1
    IOMUXC_GPR_GPR26 &= ~_hrefMask; //
#endif

    // Need to switch the IO pins back to GPI1 from GPIO6
    //_save_IOMUXC_GPR_GPR27 = IOMUXC_GPR_GPR27;  // save away the configuration
    // before we change... IOMUXC_GPR_GPR27 &= ~(0x0ff0u);

    // lets also un map the _hrefPin to GPIO1
    // IOMUXC_GPR_GPR27 &= ~_hrefMask; //

    // DebugDigitalToggle(OV7670_DEBUG_PIN_1);

    // Falling edge indicates start of frame
    //  while ((*_vsyncPort & _vsyncMask) == 0); // wait for HIGH
    //  while ((*_vsyncPort & _vsyncMask) != 0); // wait for LOW
    //  DebugDigitalWrite(OV7670_DEBUG_PIN_2, HIGH);

    // Debug stuff for now

    // We have the start of a frame, so lets start the dma.
#ifdef DEBUG_CAMERA
    dumpDMA_TCD(&_dmachannel, " CH: ");
    dumpDMA_TCD(&_dmasettings[0], " 0: ");
    dumpDMA_TCD(&_dmasettings[1], " 1: ");

    debug.printf("pclk pin: %d config:%lx control:%lx\n", _pclkPin,
                 *(portConfigRegister(_pclkPin)),
                 *(portControlRegister(_pclkPin)));
    debug.printf("IOMUXC_GPR_GPR26-29:%lx %lx %lx %lx\n", IOMUXC_GPR_GPR26,
                 IOMUXC_GPR_GPR27, IOMUXC_GPR_GPR28, IOMUXC_GPR_GPR29);
    debug.printf("GPIO1: %lx %lx, GPIO6: %lx %lx\n", GPIO1_DR, GPIO1_PSR,
                 GPIO6_DR, GPIO6_PSR);
    debug.printf("XBAR CTRL0:%x CTRL1:%x\n\n", XBARA1_CTRL0, XBARA1_CTRL1);
#endif
    _dma_state = DMASTATE_RUNNING;
    _dma_last_completed_frame = nullptr;
    _dma_frame_count = 0;

    // Now start an interrupt for start of frame.
    //  attachInterrupt(_vsyncPin, &frameStartInterrupt, RISING);

    // DebugDigitalToggle(OV7670_DEBUG_PIN_1);
    return true;
}

//===================================================================
// stopReadFrameDMA - stop doing the reading and then exit.
//===================================================================
bool OV5640::stopReadFrameDMA() {

// hopefully it start here (fingers crossed)
// for now will hang here to see if completes...
#ifdef OV7670_USE_DEBUG_PINS
// DebugDigitalWrite(OV7670_DEBUG_PIN_2, HIGH);
#endif
    elapsedMillis em = 0;
    // tell the background stuff DMA stuff to exit.
    // Note: for now let it end on on, later could disable the DMA directly.
    _dma_state = DMASTATE_STOP_REQUESTED;

    while ((em < 1000) && (_dma_state == DMASTATE_STOP_REQUESTED))
        ; // wait up to a second...
    if (_dma_state != DMA_STATE_STOPPED) {
        debug.println("*** stopReadFrameDMA DMA did not exit correctly...");
        debug.printf("  Bytes Left: %u frame buffer:%x Row:%u Col:%u\n",
                     _bytes_left_dma, (uint32_t)_frame_buffer_pointer,
                     _frame_row_index, _frame_col_index);
    }
#ifdef OV7670_USE_DEBUG_PINS
// DebugDigitalWrite(OV7670_DEBUG_PIN_2, LOW);
#endif
#ifdef DEBUG_CAMERA
    dumpDMA_TCD(&_dmachannel, nullptr);
    dumpDMA_TCD(&_dmasettings[0], nullptr);
    dumpDMA_TCD(&_dmasettings[1], nullptr);
    debug.println();
#endif
    // Lets restore some hardware pieces back to the way we found them.
#if defined(ARDUINO_TEENSY_MICROMOD)
    IOMUXC_GPR_GPR27 =
        _save_IOMUXC_GPR_GPR27; // Restore... away the configuration before we
                                // change...
#else
    IOMUXC_GPR_GPR26 =
        _save_IOMUXC_GPR_GPR26; // Restore... away the configuration before we
                                // change...
#endif
    *(portConfigRegister(_pclkPin)) = _save_pclkPin_portConfigRegister;

    return (em < 1000); // did we stop...
}

//===================================================================
// Our Frame Start interrupt.
//===================================================================
#if 0
void  OV5640::frameStartInterrupt() {
  active_dma_camera->processFrameStartInterrupt();  // lets get back to the main object...
}

void  OV5640::processFrameStartInterrupt() {
  _bytes_left_dma = (_width + _frame_ignore_cols) * _height; // for now assuming color 565 image...
  _dma_index = 0;
  _frame_col_index = 0;  // which column we are in a row
  _frame_row_index = 0;  // which row
  _save_lsb = 0xffff;
  // make sure our DMA is setup properly again. 
  _dmasettings[0].transferCount(DMABUFFER_SIZE);
  _dmasettings[0].TCD->CSR &= ~(DMA_TCD_CSR_DREQ); // Don't disable on this one
  _dmasettings[1].transferCount(DMABUFFER_SIZE);
  _dmasettings[1].TCD->CSR &= ~(DMA_TCD_CSR_DREQ); // Don't disable on this one
  _dmachannel = _dmasettings[0];  // setup the first on...
  _dmachannel.enable();
  
  detachInterrupt(_vsyncPin);
}
#endif

//===================================================================
// Our DMA interrupt.
//===================================================================
void OV5640::dmaInterrupt() {
    active_dma_camera
        ->processDMAInterrupt(); // lets get back to the main object...
}

// This version assumes only called when HREF...  as set pixclk to only fire
// when set.
void OV5640::processDMAInterrupt() {
    _dmachannel.clearInterrupt(); // tell system we processed it.
    asm("DSB");
#ifdef USE_DEBUG_PINS
// DebugDigitalWrite(OV7670_DEBUG_PIN_3, HIGH);
#endif

    if (_dma_state == DMA_STATE_STOPPED) {
        debug.println("OV5640::dmaInterrupt called when DMA_STATE_STOPPED");
        return; //
    }

    // lets guess which buffer completed.
    uint32_t *buffer;
    uint16_t buffer_size;
    _dma_index++;
    if (_dma_index & 1) {
        buffer = _dmaBuffer1;
        buffer_size = _dmasettings[0].TCD->CITER;

    } else {
        buffer = _dmaBuffer2;
        buffer_size = _dmasettings[1].TCD->CITER;
    }
    // lets try dumping a little data on 1st 2nd and last buffer.
#ifdef DEBUG_CAMERA_VERBOSE
    if ((_dma_index < 3) || (buffer_size < DMABUFFER_SIZE)) {
        debug.printf("D(%d, %d, %lu) %u : ", _dma_index, buffer_size,
                     _bytes_left_dma, pixformat);
        for (uint16_t i = 0; i < 8; i++) {
            uint16_t b = buffer[i] >> 4;
            debug.printf(" %lx(%02x)", buffer[i], b);
        }
        debug.print("...");
        for (uint16_t i = buffer_size - 8; i < buffer_size; i++) {
            uint16_t b = buffer[i] >> 4;
            debug.printf(" %lx(%02x)", buffer[i], b);
        }
        debug.println();
    }
#endif

    for (uint16_t buffer_index = 0; buffer_index < buffer_size;
         buffer_index++) {
        if (!_bytes_left_dma || (_frame_row_index >= _height))
            break;

        // only process if href high...
        uint16_t b = *buffer >> 4;
        *_frame_buffer_pointer++ = b;
        _frame_col_index++;
        if (_frame_col_index == _width) {
            // we just finished a row.
            _frame_row_index++;
            _frame_col_index = 0;
        }
        _bytes_left_dma--; // for now assuming color 565 image...
        buffer++;
    }

    if ((_frame_row_index == _height) ||
        (_bytes_left_dma == 0)) { // We finished a frame lets bail
        _dmachannel.disable();    // disable the DMA now...
#ifdef USE_DEBUG_PINS
// DebugDigitalWrite(OV7670_DEBUG_PIN_2, LOW);
#endif
#ifdef DEBUG_CAMERA_VERBOSE
        debug.println("EOF");
#endif
        _frame_row_index = 0;
        _dma_frame_count++;

        bool swap_buffers = true;

        // DebugDigitalToggle(OV7670_DEBUG_PIN_1);
        _dma_last_completed_frame = _frame_row_buffer_pointer;
        if (_callback)
            swap_buffers = (*_callback)(_dma_last_completed_frame);

        if (swap_buffers) {
            if (_frame_row_buffer_pointer != _frame_buffer_1)
                _frame_row_buffer_pointer = _frame_buffer_2;
            else
                _frame_row_buffer_pointer = _frame_buffer_2;
        }

        _frame_buffer_pointer = _frame_row_buffer_pointer;

        // DebugDigitalToggle(OV7670_DEBUG_PIN_1);

        if (_dma_state == DMASTATE_STOP_REQUESTED) {
#ifdef DEBUG_CAMERA
            debug.println("OV5640::dmaInterrupt - Stop requested");
#endif
            _dma_state = DMA_STATE_STOPPED;
        } else {
            // We need to start up our ISR for the next frame.
#if 1
            // bypass interrupt and just restart DMA...
            _bytes_left_dma = (_width + _frame_ignore_cols) *
                              _height; // for now assuming color 565 image...
            _dma_index = 0;
            _frame_col_index = 0; // which column we are in a row
            _frame_row_index = 0; // which row
            _save_lsb = 0xffff;
            // make sure our DMA is setup properly again.
            _dmasettings[0].transferCount(DMABUFFER_SIZE);
            _dmasettings[0].TCD->CSR &=
                ~(DMA_TCD_CSR_DREQ); // Don't disable on this one
            _dmasettings[1].transferCount(DMABUFFER_SIZE);
            _dmasettings[1].TCD->CSR &=
                ~(DMA_TCD_CSR_DREQ);       // Don't disable on this one
            _dmachannel = _dmasettings[0]; // setup the first on...
            _dmachannel.enable();

#else
            attachInterrupt(_vsyncPin, &frameStartInterrupt, RISING);
#endif
        }
    } else {

        if (_bytes_left_dma == (2 * DMABUFFER_SIZE)) {
            if (_dma_index & 1)
                _dmasettings[0].disableOnCompletion();
            else
                _dmasettings[1].disableOnCompletion();
        }
    }
#ifdef OV7670_USE_DEBUG_PINS
// DebugDigitalWrite(OV7670_DEBUG_PIN_3, LOW);
#endif
}

#endif // LATER
typedef struct {
    uint32_t frameTimeMicros;
    uint16_t vsyncStartCycleCount;
    uint16_t vsyncEndCycleCount;
    uint16_t hrefCount;
    uint32_t cycleCount;
    uint16_t pclkCounts[350]; // room to spare.
    uint32_t hrefStartTime[350];
    uint16_t pclkNoHrefCount;
} frameStatics_t;

frameStatics_t fstatOmni40;

void OV5640::captureFrameStatistics() {
    memset((void *)&fstatOmni40, 0, sizeof(fstatOmni40));

    // lets wait for the vsync to go high;
    while ((*_vsyncPort & _vsyncMask) != 0)
        ; // wait for HIGH
    // now lets wait for it to go low
    while ((*_vsyncPort & _vsyncMask) == 0)
        fstatOmni40.vsyncStartCycleCount++; // wait for LOW

    while ((*_hrefPort & _hrefMask) == 0)
        ; // wait for HIGH
    while ((*_pclkPort & _pclkMask) != 0)
        ; // wait for LOW

    uint32_t microsStart = micros();
    fstatOmni40.hrefStartTime[0] = microsStart;
    // now loop through until we get the next _vsynd
    // BUGBUG We know that HSYNC and PCLK on same GPIO VSYNC is not...
    uint32_t regs_prev = 0;
    // noInterrupts();
    while ((*_vsyncPort & _vsyncMask) != 0) {

        fstatOmni40.cycleCount++;
        uint32_t regs = (*_hrefPort & (_hrefMask | _pclkMask));
        if (regs != regs_prev) {
            if ((regs & _hrefMask) && ((regs_prev & _hrefMask) == 0)) {
                fstatOmni40.hrefCount++;
                fstatOmni40.hrefStartTime[fstatOmni40.hrefCount] = micros();
            }
            if ((regs & _pclkMask) && ((regs_prev & _pclkMask) == 0))
                fstatOmni40.pclkCounts[fstatOmni40.hrefCount]++;
            if ((regs & _pclkMask) && ((regs_prev & _hrefMask) == 0))
                fstatOmni40.pclkNoHrefCount++;
            regs_prev = regs;
        }
    }
    while ((*_vsyncPort & _vsyncMask) == 0)
        fstatOmni40.vsyncEndCycleCount++; // wait for LOW
    // interrupts();
    fstatOmni40.frameTimeMicros = micros() - microsStart;

    // Maybe return data. print now
    debug.printf("*** Frame Capture Data: elapsed Micros: %u loops: %u\n",
                 fstatOmni40.frameTimeMicros, fstatOmni40.cycleCount);
    debug.printf("   VSync Loops Start: %u end: %u\n",
                 fstatOmni40.vsyncStartCycleCount,
                 fstatOmni40.vsyncEndCycleCount);
    debug.printf("   href count: %u pclk ! href count: %u\n    ",
                 fstatOmni40.hrefCount, fstatOmni40.pclkNoHrefCount);
    for (uint16_t ii = 0; ii < fstatOmni40.hrefCount + 1; ii++) {
        debug.printf("%3u(%u) ", fstatOmni40.pclkCounts[ii],
                     (ii == 0) ? 0
                               : fstatOmni40.hrefStartTime[ii] -
                                     fstatOmni40.hrefStartTime[ii - 1]);
        if (!(ii & 0x0f))
            debug.print("\n    ");
    }
    debug.println();
}

/*****************************************************************/

typedef struct {
    const __FlashStringHelper *reg_name;
    uint8_t bank;
    uint16_t reg;
} OV5640_TO_NAME_t;
/*
static const OV5640_TO_NAME_t OV5640_reg_name_table[] PROGMEM{
    {F(" QS"), 0, 0x44},
    {F(" HSIZE"), 0, 0x51},
    {F(" VSIZE"), 0, 0x52},
    {F(" XOFFL"), 0, 0x53},
    {F(" YOFFL"), 0, 0x54},
    {F(" VHYX"), 0, 0x55},
    {F(" DPRP"), 0, 0x56},
    {F(" TEST"), 0, 0x57},
    {F(" ZMOW"), 0, 0x5A},
    {F(" ZMOH"), 0, 0x5B},
    {F(" ZMHH"), 0, 0x5C},
    {F(" BPADDR"), 0, 0x7C},
    {F(" BPDATA"), 0, 0x7D},
    {F(" SIZEL"), 0, 0x8C},
    {F(" HSIZE8"), 0, 0xC0},
    {F(" VSIZE8"), 0, 0xC1},
    {F(" CTRL1"), 0, 0xC3},
    {F(" MS_SP"), 0, 0xF0},
    {F(" SS_ID"), 0, 0xF7},
    {F(" SS_CTRL"), 0, 0xF7},
    {F(" MC_AL"), 0, 0xFA},
    {F(" MC_AH"), 0, 0xFB},
    {F(" MC_D"), 0, 0xFC},
    {F(" P_CMD"), 0, 0xFD},
    {F(" P_STATUS"), 0, 0xFE},
    {F(" CTRLI"), 0, 0x50},
    {F(" CTRLI_LP_DP"), 0, 0x80},
    {F(" CTRLI_ROUND"), 0, 0x40},
    {F(" CTRL0"), 0, 0xC2},
    {F(" CTRL2"), 0, 0x86},
    {F(" CTRL3"), 0, 0x87},
    {F(" R_DVP_SP"), 0, 0xD3},
    {F(" R_DVP_SP_AUTO_MODE"), 0, 0x80},
    {F(" R_BYPASS"), 0, 0x05},
    {F(" R_BYPASS_DSP_EN"), 0, 0x00},
    {F(" R_BYPASS_DSP_BYPAS"), 0, 0x01},
    {F(" IMAGE_MODE"), 0, 0xDA},
    {F(" RESET"), 0, 0xE0},
    {F(" MC_BIST"), 0, 0xF9},
    {F(" BANK_SEL"), 0, 0xFF},
    {F(" BANK_SEL_DSP"), 0, 0x00},
    {F(" BANK_SEL_SENSOR"), 0, 0x01},
    {F(" GAIN"), 1, 0x00},
    {F(" COM1"), 1, 0x03},
    {F(" REG_PID"), 1, 0x0A},
    {F(" REG_VER"), 1, 0x0B},
    {F(" COM4"), 1, 0x0D},
    {F(" AEC"), 1, 0x10},
    {F(" CLKRC"), 1, 0x11},
    {F(" CLKRC_DOUBLE"), 1, 0x82},
    {F(" CLKRC_DIVIDER_MASK"), 1, 0x3F},
    {F(" COM10"), 1, 0x15},
    {F(" HREFST"), 1, 0x17},
    {F(" HREFEND"), 1, 0x18},
    {F(" VSTRT"), 1, 0x19},
    {F(" VEND"), 1, 0x1A},
    {F(" MIDH"), 1, 0x1C},
    {F(" MIDL"), 1, 0x1D},
    {F(" AEW"), 1, 0x24},
    {F(" AEB"), 1, 0x25},
    {F(" REG2A"), 1, 0x2A},
    {F(" FRARL"), 1, 0x2B},
    {F(" ADDVSL"), 1, 0x2D},
    {F(" ADDVSH"), 1, 0x2E},
    {F(" YAVG"), 1, 0x2F},
    {F(" HSDY"), 1, 0x30},
    {F(" HEDY"), 1, 0x31},
    {F(" REG32"), 1, 0x32},
    {F(" ARCOM2"), 1, 0x34},
    {F(" REG45"), 1, 0x45},
    {F(" FLL"), 1, 0x46},
    {F(" FLH"), 1, 0x47},
    {F(" COM19"), 1, 0x48},
    {F(" ZOOMS"), 1, 0x49},
    {F(" COM22"), 1, 0x4B},
    {F(" COM25"), 1, 0x4E},
    {F(" BD50"), 1, 0x4F},
    {F(" BD60"), 1, 0x50},
    {F(" REG5D"), 1, 0x5D},
    {F(" REG5E"), 1, 0x5E},
    {F(" REG5F"), 1, 0x5F},
    {F(" REG60"), 1, 0x60},
    {F(" HISTO_LOW"), 1, 0x61},
    {F(" HISTO_HIGH"), 1, 0x62},
    {F(" REG04"), 1, 0x04},
    {F(" REG08"), 1, 0x08},
    {F(" COM2"), 1, 0x09},
    {F(" COM2_STDBY"), 1, 0x10},
    {F(" COM3"), 1, 0x0C},
    {F(" COM7"), 1, 0x12},
    {F(" COM8"), 1, 0x13},
    {F(" COM8_DEFAULT"), 1, 0xC0},
    {F(" COM8_BNDF_EN"), 1, 0x20},
    {F(" COM8_AGC_EN"), 1, 0x04},
    {F(" COM8_AEC_EN"), 1, 0x01},
    {F(" COM9"), 1, 0x14},
    {F(" CTRL1_AWB"), 1, 0x08},
    {F(" VV"), 1, 0x26},
    {F(" REG32"), 1, 0x32},
};

#define CNT_REG_NAME_TABLE                                                     \
    (sizeof(OV2640_reg_name_table) / sizeof(OV2640_reg_name_table[0]))

#ifdef DEBUG_CAMERA_REG
void Debug_printCameraWriteRegister(uint8_t reg, uint8_t data) {
    static uint8_t showing_bank = 0;
    static uint16_t bank_1_starts_at = 0;
    uint16_t ii = CNT_REG_NAME_TABLE; // initialize to remove warning

    debug.printf("cameraWriteRegister(%x, %x)", reg, data);
    if (reg == 0xff)
        showing_bank = data; // remember which bank we are
    else {
        if (showing_bank == 0) {
            for (ii = 0; ii < CNT_REG_NAME_TABLE; ii++) {
                if (OV2640_reg_name_table[ii].bank != 0)
                    break;
                if (reg == OV2640_reg_name_table[ii].reg)
                    break;
            }
        } else {
            if (bank_1_starts_at == 0) {
                for (ii = bank_1_starts_at; ii < CNT_REG_NAME_TABLE; ii++) {
                    if (OV2640_reg_name_table[ii].bank != 0) {
                        bank_1_starts_at = ii;
                        break;
                    }
                }
            }
            for (ii = bank_1_starts_at; ii < CNT_REG_NAME_TABLE; ii++) {
                if (reg == OV2640_reg_name_table[ii].reg)
                    break;
            }
        }
    }
    if ((ii < CNT_REG_NAME_TABLE) && (reg == OV2640_reg_name_table[ii].reg))
        debug.printf(" - %s\n", OV2640_reg_name_table[ii].reg_name);
    else
        debug.println();
}

#endif

void OV5640::showRegisters(void) {
    debug.println("\n*** Camera Registers ***");
    cameraWriteRegister(0xFF, 0x00); // bank 0
    bool showing_bank_0 = true;
    for (uint16_t ii = 0; ii < (sizeof(OV2640_reg_name_table) /
                                sizeof(OV2640_reg_name_table[0]));
         ii++) {
        if ((OV2640_reg_name_table[ii].bank != 0) && showing_bank_0) {
            cameraWriteRegister(0xff, 0x01);
            showing_bank_0 = false;
        }
        uint8_t reg_value = cameraReadRegister(OV2640_reg_name_table[ii].reg);
        debug.printf("(%d) %s(%x): %u(%x)\n", OV2640_reg_name_table[ii].bank,
                     OV2640_reg_name_table[ii].reg_name,
                     OV2640_reg_name_table[ii].reg, reg_value, reg_value);
    }

    // Quick and dirty print out WIndows start and end:
    uint8_t reg32_reg = cameraReadRegister(REG32);
    uint8_t com1_reg = cameraReadRegister(COM1);

    uint16_t hstart = (cameraReadRegister(HREFST) << 3) | (reg32_reg & 0x7);
    uint16_t hstop =
        (cameraReadRegister(HREFEND) << 3) | ((reg32_reg >> 3) & 0x7);
    uint16_t vstart = (cameraReadRegister(VSTRT) << 2) | (com1_reg & 0x3);
    uint16_t vstop = (cameraReadRegister(VEND) << 2) | ((com1_reg >> 2) & 0x3);

    debug.printf(
        "Window Hor: (%u - %u) = %u * 2 = %u Vert: (%u - %u) = %u * 2 = %u\n",
        hstart, hstop, hstop - hstart, (hstop - hstart) * 2, vstart, vstop,
        vstop - vstart, (vstop - vstart) * 2);

    cameraWriteRegister(0xFF, 0x00); // bank 0

    uint8_t vhyx_reg = cameraReadRegister(VHYX);

    uint8_t hsize = cameraReadRegister(HSIZE) | ((vhyx_reg >> 3) & 1) << 8;
    uint8_t vsize = cameraReadRegister(VSIZE) | ((vhyx_reg >> 7) & 1) << 8;

    debug.printf("device\tSize H: %u * 4 = %u V: %u * 4 = %u\n", hsize,
                 hsize * 4, vsize, vsize * 4);

    uint16_t xoffl = cameraReadRegister(XOFFL) | ((vhyx_reg >> 0) & 0x7) << 8;
    uint16_t yoffl = cameraReadRegister(YOFFL) | ((vhyx_reg >> 4) & 0x7) << 8;
    debug.printf("\t offset H: %u V: %u \n", xoffl, yoffl);
}
*/